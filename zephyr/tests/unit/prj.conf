## CMakeLists.txt
```
# Copyright (c) Meta Platforms, Inc. and affiliates.
#
# Licensed under the Apache License, Version 2.0 (the "License");
# you may not use this file except in compliance with the License.
# You may obtain a copy of the License at
#
#     http://www.apache.org/licenses/LICENSE-2.0
#
# Unless required by applicable law or agreed to in writing, software
# distributed under the License is distributed on an "AS IS" BASIS,
# WITHOUT WARRANTIES OR CONDITIONS OF ANY KIND, either express or implied.
# See the License for the specific language governing permissions and
# limitations under the License.

cmake_minimum_required(VERSION 3.20.0)

find_package(Zephyr REQUIRED HINTS $ENV{ZEPHYR_BASE})
project(mg_unit)

set(MG_SRC ${CMAKE_CURRENT_SOURCE_DIR}/../../src)
include(${CMAKE_CURRENT_SOURCE_DIR}/../../cmake/mg_common.cmake)

target_include_directories(app PRIVATE ${MG_PROTOCOLS} ${MG_SRC} src ${CMAKE_CURRENT_BINARY_DIR})

# The portable modules under test; the rest (BLE, audio thread, LED) are
# replaced by src/fakes.c.
target_sources(app PRIVATE
  ${MG_SRC}/mg_core.c
  ${MG_SRC}/mg_settings.c
  ${MG_SRC}/mg_session.c
  ${MG_SRC}/mg_identity.c
  ${MG_SRC}/mg_json.c
  ${MG_SRC}/mg_psa.c
  ${MG_SRC}/mg_setup.c
  ${MG_SRC}/mg_setup_crypto.c
  ${MG_SRC}/mg_setup_store.c
  ${MG_SRC}/mg_token_proof.c
  ${MG_SRC}/mg_codec.c
  ${MG_SRC}/mg_queue.c
  ${MG_SRC}/mg_hpf.c
  ${MG_SRC}/mg_connparam.c
  ${MG_SRC}/mg_throughput.c
  src/fakes.c
  src/test_settings.c
  src/test_core.c
  src/test_codec.c
  src/test_queue.c
  src/test_hpf.c
  src/test_connparam.c
  src/test_throughput.c
  src/test_proof.c
)

if(CONFIG_MG_SECURE)
  target_sources(app PRIVATE ${MG_SRC}/mg_crypto.c ${MG_SRC}/mg_pairing.c src/test_secure.c)
endif()

mg_add_sbc(app)
mg_add_lc3(app)

mg_add_transcript(app)

# Link setup and token proof vectors, straight from the JSON files.
set(LINK_JSON ${MG_ROOT}/../esp32/tests/vectors/link_pairing_v5.json)
set(PROOF_JSON ${MG_PROTOCOLS}/test-vectors/mg-token-proof-v1.json)
set(GEN ${CMAKE_CURRENT_SOURCE_DIR}/../host/gen_vectors.py)
add_custom_command(
  OUTPUT ${CMAKE_CURRENT_BINARY_DIR}/vectors.h
  COMMAND ${PYTHON_EXECUTABLE} ${GEN} ${LINK_JSON} ${PROOF_JSON} ${CMAKE_CURRENT_BINARY_DIR}/vectors.h
  DEPENDS ${LINK_JSON} ${PROOF_JSON} ${GEN}
)
add_custom_target(mg_vectors DEPENDS ${CMAKE_CURRENT_BINARY_DIR}/vectors.h)
add_dependencies(app mg_vectors)

# Session security vectors, straight from the JSON the reference generates.
set(VEC_JSON ${MG_PROTOCOLS}/test-vectors/mgcommands-secure-v1.json)
add_custom_command(
  OUTPUT ${CMAKE_CURRENT_BINARY_DIR}/mg_vectors.h
  COMMAND ${PYTHON_EXECUTABLE} ${CMAKE_CURRENT_SOURCE_DIR}/gen_vectors.py ${VEC_JSON}
          ${CMAKE_CURRENT_BINARY_DIR}/mg_vectors.h
  DEPENDS ${VEC_JSON} ${CMAKE_CURRENT_SOURCE_DIR}/gen_vectors.py
)
add_custom_target(mg_secure_vectors DEPENDS ${CMAKE_CURRENT_BINARY_DIR}/mg_vectors.h)
add_dependencies(app mg_secure_vectors)
```

## Kconfig
```
# Copyright (c) Meta Platforms, Inc. and affiliates.
#
# Licensed under the Apache License, Version 2.0 (the "License");
# you may not use this file except in compliance with the License.
# You may obtain a copy of the License at
#
#     http://www.apache.org/licenses/LICENSE-2.0
#
# Unless required by applicable law or agreed to in writing, software
# distributed under the License is distributed on an "AS IS" BASIS,
# WITHOUT WARRANTIES OR CONDITIONS OF ANY KIND, either express or implied.
# See the License for the specific language governing permissions and
# limitations under the License.

rsource "../../Kconfig.mg"
source "Kconfig.zephyr"
```

## prj.conf
```kconfig
# Copyright (c) Meta Platforms, Inc. and affiliates.
#
# Licensed under the Apache License, Version 2.0 (the "License");
# you may not use this file except in compliance with the License.
# You may obtain a copy of the License at
#
#     http://www.apache.org/licenses/LICENSE-2.0
#
# Unless required by applicable law or agreed to in writing, software
# distributed under the License is distributed on an "AS IS" BASIS,
# WITHOUT WARRANTIES OR CONDITIONS OF ANY KIND, either express or implied.
# See the License for the specific language governing permissions and
# limitations under the License.

CONFIG_ZTEST=y
CONFIG_ZTEST_STACK_SIZE=16384
CONFIG_MAIN_STACK_SIZE=4096

CONFIG_FLASH=y
CONFIG_FLASH_MAP=y
CONFIG_ZMS=y
CONFIG_SETTINGS=y
CONFIG_SETTINGS_ZMS=y
CONFIG_CRC=y

CONFIG_MG_AUDIO_SRC_SYNTH=y
CONFIG_MG_NUS=n
CONFIG_MG_LC3=y
# A board with a vibration motor and a status light; the slot1 configuration
# turns haptics off, like the XIAO.
CONFIG_MG_HAPTICS=y
CONFIG_MG_ASSISTANT_STATE=y

# PSA Crypto (Link setup, token proof) needs a random source on native_sim.
CONFIG_TEST_RANDOM_GENERATOR=y
CONFIG_MBEDTLS_PSA_CRYPTO_EXTERNAL_RNG_ALLOW_NON_CSPRNG=y
CONFIG_MBEDTLS_PSA_KEY_SLOT_COUNT=16
CONFIG_MG_SDK_TOKEN="mgst_unit_test"

CONFIG_LOG=y
CONFIG_LOG_MODE_IMMEDIATE=y
CONFIG_ASSERT=y
CONFIG_CBPRINTF_FP_SUPPORT=y
```

## app.overlay
```dts
/*
 * Copyright (c) Meta Platforms, Inc. and affiliates.
 *
 * Licensed under the Apache License, Version 2.0 (the "License");
 * you may not use this file except in compliance with the License.
 * You may obtain a copy of the License at
 *
 *     http://www.apache.org/licenses/LICENSE-2.0
 *
 * Unless required by applicable law or agreed to in writing, software
 * distributed under the License is distributed on an "AS IS" BASIS,
 * WITHOUT WARRANTIES OR CONDITIONS OF ANY KIND, either express or implied.
 * See the License for the specific language governing permissions and
 * limitations under the License.
 */

/* Flash simulator partitions: settings and the offline clip queue. */

/delete-node/ &slot1_partition;

&flash0 {
	partitions {
		audio_queue_partition: partition@75000 {
			label = "audio-queue";
			reg = <0x00075000 0x00069000>;
		};
	};
};
```

## slot1.overlay
```dts
/*
 * Copyright (c) Meta Platforms, Inc. and affiliates.
 *
 * Licensed under the Apache License, Version 2.0 (the "License");
 * you may not use this file except in compliance with the License.
 * You may obtain a copy of the License at
 *
 *     http://www.apache.org/licenses/LICENSE-2.0
 *
 * Unless required by applicable law or agreed to in writing, software
 * distributed under the License is distributed on an "AS IS" BASIS,
 * WITHOUT WARRANTIES OR CONDITIONS OF ANY KIND, either express or implied.
 * See the License for the specific language governing permissions and
 * limitations under the License.
 */

/* The queue in MCUboot's secondary slot (CONFIG_MG_QUEUE_IN_SLOT1): native_sim's
 * own slot1_partition, as on the XIAO. Replaces app.overlay. */
```

## src/fakes.c
```c
/*
 * Copyright (c) Meta Platforms, Inc. and affiliates.
 *
 * Licensed under the Apache License, Version 2.0 (the "License");
 * you may not use this file except in compliance with the License.
 * You may obtain a copy of the License at
 *
 *     http://www.apache.org/licenses/LICENSE-2.0
 *
 * Unless required by applicable law or agreed to in writing, software
 * distributed under the License is distributed on an "AS IS" BASIS,
 * WITHOUT WARRANTIES OR CONDITIONS OF ANY KIND, either express or implied.
 * See the License for the specific language governing permissions and
 * limitations under the License.
 */

#include "fakes.h"

#include <errno.h>
#include <string.h>

#include <zephyr/kernel.h>

#include "mg_led.h"
#include "mg_session.h"
#include "mg_settings.h"

struct fake_note fake_notes[FAKE_MAX_NOTES];
int fake_nnotes;
uint16_t fake_mtu = 247;
int fake_disconnects;
int fake_buzzes;
uint32_t fake_led_flags;

int fake_audio_starts;
uint8_t fake_audio_codec;
bool fake_audio_ptt;
int fake_audio_stops;
int fake_audio_recordings;
int fake_audio_clip_reads;
uint16_t fake_audio_clip;
uint8_t fake_audio_gain;
enum mg_audio_activity fake_audio_state;

void fake_reset(void)
{
	fake_nnotes = 0;
	fake_mtu = 247;
	fake_disconnects = 0;
	fake_buzzes = 0;
	fake_audio_starts = 0;
	fake_audio_codec = 0;
	fake_audio_ptt = false;
	fake_audio_stops = 0;
	fake_audio_recordings = 0;
	fake_audio_clip_reads = 0;
	fake_audio_state = MG_AUDIO_IDLE;
}

const struct fake_note *fake_find(uint8_t ch, uint8_t cmd, int nth)
{
	for (int i = 0; i < fake_nnotes; i++) {
		if (fake_notes[i].ch == ch && fake_notes[i].len > 0 &&
		    fake_notes[i].data[0] == cmd && nth-- == 0) {
			return &fake_notes[i];
		}
	}
	return NULL;
}

int fake_count(uint8_t ch, uint8_t cmd)
{
	int n = 0;

	while (fake_find(ch, cmd, n)) {
		n++;
	}
	return n;
}

void fake_connect(void)
{
	mg_session_connected();
	mg_session_subscribed(MG_ATT_CONTROL, true);
	mg_session_subscribed(MG_ATT_DATA, true);
#if defined(CONFIG_MG_SECURE)
	mg_session_subscribed(MG_ATT_ENC_CONTROL, true);
	mg_session_subscribed(MG_ATT_ENC_DATA, true);
#endif
}

/* Transport */

int fake_notify_delay_us;
int fake_data_notes;

int mg_transport_notify(enum mg_att_chan ch, const uint8_t *buf, size_t len, k_timeout_t wait)
{
	ARG_UNUSED(wait);
	if (ch == MG_ATT_DATA || ch == MG_ATT_ENC_DATA) {
		fake_data_notes++;
		if (fake_notify_delay_us) {
			k_sleep(K_USEC(fake_notify_delay_us));
			return 0; /* not kept: a test stream would fill the list */
		}
	}
	if (fake_nnotes == FAKE_MAX_NOTES || len > sizeof(fake_notes[0].data)) {
		return -ENOMEM;
	}
	fake_notes[fake_nnotes].ch = ch;
	fake_notes[fake_nnotes].len = len;
	memcpy(fake_notes[fake_nnotes].data, buf, len);
	fake_nnotes++;
	return 0;
}

void mg_transport_disconnect(void)
{
	fake_disconnects++;
}

uint16_t mg_transport_att_mtu(void)
{
	return fake_mtu;
}

const char *mg_transport_name(void)
{
	return "MuseGadget-A1B2C3";
}

const char *mg_app_version(void)
{
	return "1.0.0";
}

void mg_ble_refresh_advertising(void)
{
}

struct k_work_q *mg_app_wq(void)
{
	return &k_sys_work_q;
}

/* LED */

void mg_led_set(uint32_t flag, bool on)
{
	if (on) {
		fake_led_flags |= flag;
	} else {
		fake_led_flags &= ~flag;
	}
}

struct fake_conn_req fake_conn_reqs[16];
int fake_nconn_reqs;

int mg_transport_conn_params(uint16_t interval_min, uint16_t interval_max, uint16_t latency,
			     uint16_t timeout)
{
	if (fake_nconn_reqs < (int)ARRAY_SIZE(fake_conn_reqs)) {
		fake_conn_reqs[fake_nconn_reqs] = (struct fake_conn_req){
			interval_min, interval_max, latency, timeout};
	}
	fake_nconn_reqs++;
	return 0;
}

int fake_led_link;
int fake_led_face;
int fake_led_faces;

void mg_led_set_link(enum mg_led_link link)
{
	fake_led_link = link;
}

void mg_led_set_face(enum mg_led_face face, const char *why)
{
	ARG_UNUSED(why);
	fake_led_face = face;
	fake_led_faces++;
}

enum mg_led_face mg_led_face(void)
{
	return fake_led_face;
}

const char *mg_led_link_name(enum mg_led_link link)
{
	static const char *const n[] = {"never", "disconnected", "connecting", "session", "ready"};

	return link < ARRAY_SIZE(n) ? n[link] : "?";
}

void mg_led_buzz(uint16_t freq_hz, uint16_t duration_ms, uint8_t volume)
{
	ARG_UNUSED(freq_hz);
	ARG_UNUSED(duration_ms);
	ARG_UNUSED(volume);
	fake_buzzes++;
}

/* Audio thread */

int mg_audio_start_live(uint8_t codec, bool ptt)
{
	fake_audio_starts++;
	fake_audio_codec = codec;
	fake_audio_ptt = ptt;
	fake_audio_state = MG_AUDIO_LIVE;
	return 0;
}

int mg_audio_start_recording(uint8_t codec)
{
	fake_audio_recordings++;
	fake_audio_codec = codec;
	fake_audio_state = MG_AUDIO_RECORDING;
	return 0;
}

int mg_audio_read_clip(uint16_t index)
{
	fake_audio_clip_reads++;
	fake_audio_clip = index;
	fake_audio_state = MG_AUDIO_CLIP;
	return 0;
}

void mg_audio_stop(void)
{
	fake_audio_stops++;
	fake_audio_state = MG_AUDIO_IDLE;
}

enum mg_audio_activity mg_audio_activity(void)
{
	return fake_audio_state;
}

void mg_audio_current_format(struct mg_audio_format *fmt)
{
	(void)mg_codec_format(mg_settings_get()->audio_codec, fmt);
}

void mg_audio_set_gain(uint8_t gain)
{
	fake_audio_gain = gain;
}

/* One-time bring-up shared by the suites. */
#include <zephyr/settings/settings.h>

#include "mg_core.h"
#include "mg_identity.h"
#include "mg_queue.h"
#include "mg_setup.h"
#include "mg_setup_store.h"

void fake_init_once(void)
{
	static bool done;

	if (done) {
		return;
	}
	done = true;
	(void)settings_subsys_init();
	(void)mg_settings_load();
	(void)mg_setup_store_load();
	(void)mg_queue_init();
	mg_core_init();
	static const uint8_t addr[6] = {0x02, 0, 0, 0, 0, 0x01};

	mg_identity_init("MuseGadget-", addr);
	mg_setup_init();
	mg_session_init(false);
}
```

## src/fakes.h
```c
/*
 * Copyright (c) Meta Platforms, Inc. and affiliates.
 *
 * Licensed under the Apache License, Version 2.0 (the "License");
 * you may not use this file except in compliance with the License.
 * You may obtain a copy of the License at
 *
 *     http://www.apache.org/licenses/LICENSE-2.0
 *
 * Unless required by applicable law or agreed to in writing, software
 * distributed under the License is distributed on an "AS IS" BASIS,
 * WITHOUT WARRANTIES OR CONDITIONS OF ANY KIND, either express or implied.
 * See the License for the specific language governing permissions and
 * limitations under the License.
 */

#ifndef FAKES_H_
#define FAKES_H_

#include <stdbool.h>
#include <stdint.h>

#include "mg_audio.h"
#include "mg_transport.h"

struct fake_note {
	uint8_t ch;
	uint16_t len;
	uint8_t data[260];
};

#define FAKE_MAX_NOTES 64
extern struct fake_note fake_notes[FAKE_MAX_NOTES];
extern int fake_nnotes;
extern uint16_t fake_mtu;
extern int fake_disconnects;
extern int fake_buzzes;
extern uint32_t fake_led_flags;
extern int fake_led_link;
extern int fake_led_face;
extern int fake_led_faces; /* face changes */

/* Connection parameter requests (mg_transport_conn_params). */
struct fake_conn_req {
	uint16_t min, max, latency, timeout;
};
extern struct fake_conn_req fake_conn_reqs[16];
extern int fake_nconn_reqs;

/* Audio calls mg_core made. */
extern int fake_audio_starts;
extern uint8_t fake_audio_codec;
extern bool fake_audio_ptt;
extern int fake_audio_stops;
extern int fake_audio_recordings;
extern int fake_audio_clip_reads;
extern uint16_t fake_audio_clip;
extern uint8_t fake_audio_gain;
extern enum mg_audio_activity fake_audio_state;

/* Sleep this long in each Data notification (paces a sending thread). */
extern int fake_notify_delay_us;
/* Data notifications seen, and how many (counted even past FAKE_MAX_NOTES). */
extern int fake_data_notes;

void fake_reset(void);
/* nth (0-based) notification on ch whose first byte is cmd, or NULL. */
const struct fake_note *fake_find(uint8_t ch, uint8_t cmd, int nth);
int fake_count(uint8_t ch, uint8_t cmd);
/* Connects and subscribes the characteristics a session needs. */
void fake_connect(void);
/* settings, queue, core and session, once. */
void fake_init_once(void);

#endif
```

## src/test_codec.c
```c
/*
 * Copyright (c) Meta Platforms, Inc. and affiliates.
 *
 * Licensed under the Apache License, Version 2.0 (the "License");
 * you may not use this file except in compliance with the License.
 * You may obtain a copy of the License at
 *
 *     http://www.apache.org/licenses/LICENSE-2.0
 *
 * Unless required by applicable law or agreed to in writing, software
 * distributed under the License is distributed on an "AS IS" BASIS,
 * WITHOUT WARRANTIES OR CONDITIONS OF ANY KIND, either express or implied.
 * See the License for the specific language governing permissions and
 * limitations under the License.
 */

#include <math.h>
#include <stdio.h>
#include <string.h>

#include <zephyr/ztest.h>

#include <lc3.h>
#include <sbc.h>

#include "mg_codec.h"

/*
 * Encodes one second of a two-tone signal with each codec, decodes it with
 * the vendored decoder and checks the frame format and the SNR at the best
 * alignment. The encoded streams are also printed (MGSTREAM lines) so
 * tests/tools/xcheck.py can decode them with the upstream reference
 * decoders.
 */

#define RATE    16000
#define SECONDS 1
#define N       (RATE * SECONDS)

static int16_t pcm_in[N];
static int16_t pcm_out[N + 400];
static uint8_t stream[16000];

static void make_signal(void)
{
	for (int i = 0; i < N; i++) {
		float t = (float)i / RATE;

		pcm_in[i] = (int16_t)(6000.0f * sinf(2 * 3.14159265f * 440.0f * t) +
				      3000.0f * sinf(2 * 3.14159265f * 1500.0f * t));
	}
}

/* SNR (dB) of out against in, at the lag in [0, max_lag] that fits best,
 * skipping the first 50 ms. */
static double best_snr(const int16_t *out, int n_out, int max_lag, int *lag_out)
{
	double best = -100;

	for (int lag = 0; lag <= max_lag; lag++) {
		double sig = 0, err = 0;

		for (int i = 800; i + lag < n_out && i < N; i++) {
			double d = (double)out[i + lag] - pcm_in[i];

			sig += (double)pcm_in[i] * pcm_in[i];
			err += d * d;
		}
		double snr = 10 * log10(sig / (err + 1e-9));

		if (snr > best) {
			best = snr;
			*lag_out = lag;
		}
	}
	return best;
}

static void dump(const char *name, const uint8_t *b, size_t n)
{
	char line[2 * 64 + 1];

	for (size_t off = 0; off < n; off += 64) {
		size_t m = MIN((size_t)64, n - off);

		for (size_t i = 0; i < m; i++) {
			snprintf(&line[2 * i], 3, "%02x", b[off + i]);
		}
		printk("MGSTREAM %s %s\n", name, line);
	}
}

ZTEST(codec, test_formats)
{
	struct mg_audio_format f;

	zassert_equal(mg_codec_format(mg_data_type_audio_sbc, &f), 0);
	zassert_equal(f.frame_samples, 128);
	zassert_equal(f.frame_bytes, 60, "bitpool 26: 4 + 4 + 52 bytes");
	zassert_equal(f.frame_us, 8000);
	zassert_equal(f.sample_rate, 16000);
	zassert_equal(f.channels, 1);

	zassert_equal(mg_codec_format(mg_data_type_audio_lc3, &f), 0);
	zassert_equal(f.frame_samples, 160);
	zassert_equal(f.frame_bytes, MG_LC3_DEFAULT_FRAME_BYTES);
	zassert_equal(f.frame_us, MG_LC3_DEFAULT_FRAME_US);

	zassert_equal(mg_codec_format(mg_data_type_audio_opus, &f), -ENOTSUP);
	zassert_equal(mg_codec_format(mg_data_type_audio_pcm, &f), -ENOTSUP);

	uint8_t buf[9];

	zassert_equal(mg_codec_format(mg_data_type_audio_lc3, &f), 0);
	zassert_equal(mg_codec_change_data_type(&f, buf), 9);
	const uint8_t want[] = {mg_command_change_data_type, mg_data_type_audio_lc3, 0x80, 0x3e, 1,
				40, 0, 0x10, 0x27};
	zassert_mem_equal(buf, want, sizeof(want));
}

ZTEST(codec, test_sbc_roundtrip)
{
	struct mg_audio_format f;
	size_t len = 0;
	int nframes = 0;

	make_signal();
	zassert_equal(mg_codec_format(mg_data_type_audio_sbc, &f), 0);
	zassert_equal(mg_codec_open(mg_data_type_audio_sbc), 0);
	for (int i = 0; i + f.frame_samples <= N; i += f.frame_samples) {
		int n = mg_codec_encode(&pcm_in[i], &stream[len], sizeof(stream) - len);

		zassert_equal(n, 60);
		/* Header: syncword, 16 kHz / 16 blocks / mono / loudness / 8 subbands,
		 * bitpool. */
		zassert_equal(stream[len], 0x9c);
		zassert_equal(stream[len + 1], 0x31, "got 0x%02x", stream[len + 1]);
		zassert_equal(stream[len + 2], CONFIG_MG_SBC_BITPOOL);
		len += n;
		nframes++;
	}
	dump("sbc", stream, len);

	/* Decode with the vendored decoder. */
	sbc_t dec;
	struct sbc_frame fr;
	int out = 0;

	sbc_reset(&dec);
	for (size_t off = 0; off < len; off += 60) {
		zassert_equal(sbc_probe(&stream[off], &fr), 0);
		zassert_false(fr.msbc);
		zassert_equal(fr.freq, SBC_FREQ_16K);
		zassert_equal(fr.mode, SBC_MODE_MONO);
		zassert_equal(fr.bam, SBC_BAM_LOUDNESS);
		zassert_equal(fr.nblocks, 16);
		zassert_equal(fr.nsubbands, 8);
		zassert_equal(sbc_get_frame_size(&fr), 60);
		zassert_equal(sbc_decode(&dec, &stream[off], 60, &fr, &pcm_out[out], 1, NULL, 0), 0);
		out += 128;
	}
	int lag = 0;
	double snr = best_snr(pcm_out, out, 200, &lag);

	printk("SBC: %d frames, %u bytes (%u kb/s), SNR %.1f dB at lag %d\n", nframes,
	       (unsigned)len, (unsigned)(len * 8 / SECONDS / 1000), snr, lag);
	zassert_true(snr > 20.0, "SBC SNR %.1f dB", snr);
}

ZTEST(codec, test_lc3_roundtrip)
{
	static LC3_DECODER_MEM_T(10000, 16000) dmem;
	struct mg_audio_format f;
	size_t len = 0;
	int out = 0;

	make_signal();
	zassert_equal(mg_codec_format(mg_data_type_audio_lc3, &f), 0);
	zassert_equal(mg_codec_open(mg_data_type_audio_lc3), 0);
	for (int i = 0; i + f.frame_samples <= N; i += f.frame_samples) {
		int n = mg_codec_encode(&pcm_in[i], &stream[len], sizeof(stream) - len);

		zassert_equal(n, 40);
		len += n;
	}
	dump("lc3", stream, len);

	lc3_decoder_t dec = lc3_setup_decoder(10000, 16000, 0, &dmem);

	zassert_not_null(dec);
	for (size_t off = 0; off < len; off += 40) {
		zassert_equal(lc3_decode(dec, &stream[off], 40, LC3_PCM_FORMAT_S16, &pcm_out[out], 1),
			      0, "frame at %u failed", (unsigned)off);
		out += 160;
	}
	int lag = 0;
	double snr = best_snr(pcm_out, out, 200, &lag);

	printk("LC3: %u frames, %u bytes (%u kb/s), SNR %.1f dB at lag %d\n",
	       (unsigned)(len / 40), (unsigned)len, (unsigned)(len * 8 / SECONDS / 1000), snr, lag);
	zassert_true(snr > 12.0, "LC3 SNR %.1f dB", snr);
}

ZTEST(codec, test_bad_codec)
{
	uint8_t out[64];
	int16_t pcm[160] = {0};

	zassert_equal(mg_codec_open(mg_data_type_audio_opus), -ENOTSUP);
	zassert_equal(mg_codec_open(mg_data_type_audio_sbc), 0);
	zassert_equal(mg_codec_encode(pcm, out, 10), -ENOMEM, "no room for a frame");
}

ZTEST_SUITE(codec, NULL, NULL, NULL, NULL, NULL);
```

## src/test_connparam.c
```c
/*
 * Copyright (c) Meta Platforms, Inc. and affiliates.
 *
 * Licensed under the Apache License, Version 2.0 (the "License");
 * you may not use this file except in compliance with the License.
 * You may obtain a copy of the License at
 *
 *     http://www.apache.org/licenses/LICENSE-2.0
 *
 * Unless required by applicable law or agreed to in writing, software
 * distributed under the License is distributed on an "AS IS" BASIS,
 * WITHOUT WARRANTIES OR CONDITIONS OF ANY KIND, either express or implied.
 * See the License for the specific language governing permissions and
 * limitations under the License.
 */


#include <zephyr/ztest.h>

#include "fakes.h"
#include "mg_connparam.h"

#define MIN_I CONFIG_MG_CONN_INTERVAL_MIN
#define MAX_I CONFIG_MG_CONN_INTERVAL_MAX
#define LAT   CONFIG_MG_CONN_LATENCY
#define TMO   CONFIG_MG_CONN_TIMEOUT
#define HOLD  CONFIG_MG_CONN_LATENCY_HOLD_MS

static void *setup(void)
{
	fake_init_once();
	mg_connparam_init();
	return NULL;
}

static void before(void *f)
{
	ARG_UNUSED(f);
	mg_connparam_disconnected();
	fake_nconn_reqs = 0;
}

static void settle(void)
{
	k_sleep(K_MSEC(10));
}

static void assert_req(int i, uint16_t latency)
{
	zassert_true(fake_nconn_reqs > i, "request %d not sent (%d)", i, fake_nconn_reqs);
	zassert_equal(fake_conn_reqs[i].min, MIN_I);
	zassert_equal(fake_conn_reqs[i].max, MAX_I);
	zassert_equal(fake_conn_reqs[i].latency, latency, "latency %u", fake_conn_reqs[i].latency);
	zassert_equal(fake_conn_reqs[i].timeout, TMO);
}

/* The defaults satisfy Apple's accessory rules. */
ZTEST(connparam, test_apple_rules)
{
	zassert_equal(MIN_I, 12, "15 ms, not 7.5-15 ms");
	zassert_equal(MAX_I, 12);
	zassert_true(MIN_I * 5 >= 60, "interval >= 15 ms");
	zassert_true(MIN_I == MAX_I || MAX_I * 5 >= MIN_I * 5 + 60);
	zassert_true(LAT <= 30);
	zassert_true(TMO >= 200 && TMO <= 600, "2-6 s");
	/* interval max x (latency + 1) x 3 < timeout, in ms */
	zassert_true(MAX_I * 125 / 100 * (LAT + 1) * 3 < TMO * 10);
#if defined(CONFIG_BT_PERIPHERAL_PREF_MIN_INT)
	zassert_equal(CONFIG_BT_PERIPHERAL_PREF_MIN_INT, MIN_I, "GAP PPCP says the same");
	zassert_equal(CONFIG_BT_PERIPHERAL_PREF_MAX_INT, MAX_I);
	zassert_equal(CONFIG_BT_PERIPHERAL_PREF_LATENCY, LAT);
	zassert_equal(CONFIG_BT_PERIPHERAL_PREF_TIMEOUT, TMO);
#endif
}

/* Asked once the PHY and data length updates are done (or after 2 s). */
ZTEST(connparam, test_initial_request)
{
	mg_connparam_connected();
	settle();
	zassert_equal(fake_nconn_reqs, 0, "waits for PHY and data length");
	mg_connparam_phy_done();
	settle();
	zassert_equal(fake_nconn_reqs, 0);
	mg_connparam_data_len_done();
	settle();
	assert_req(0, LAT);
	mg_connparam_updated(MIN_I, LAT, TMO);
	k_sleep(K_SECONDS(10));
	zassert_equal(fake_nconn_reqs, 1, "granted: nothing more");

	/* A central that never reports PHY or data length: asked after 2 s. */
	mg_connparam_disconnected();
	fake_nconn_reqs = 0;
	mg_connparam_connected();
	k_sleep(K_MSEC(1900));
	zassert_equal(fake_nconn_reqs, 0);
	k_sleep(K_MSEC(200));
	assert_req(0, LAT);
}

/* Not granted: asked once more, then the central's choice stands. */
ZTEST(connparam, test_retry_once)
{
	mg_connparam_connected();
	mg_connparam_phy_done();
	mg_connparam_data_len_done();
	settle();
	assert_req(0, LAT);
	mg_connparam_updated(24, 0, 500); /* the central's own: 30 ms */
	k_sleep(K_MSEC(5100));
	assert_req(1, LAT);
	k_sleep(K_SECONDS(30));
	zassert_equal(fake_nconn_reqs, 2, "no third request");
}

/* Phone->device transfers turn latency off, and it comes back 2 s after. */
ZTEST(connparam, test_latency_off_while_streaming_to_device)
{
	mg_connparam_connected();
	mg_connparam_phy_done();
	mg_connparam_data_len_done();
	settle();
	mg_connparam_updated(MIN_I, LAT, TMO);
	settle();
	zassert_equal(fake_nconn_reqs, 1);
	zassert_false(mg_connparam_latency_off());

	/* An SMP upload: a chunk every 50 ms for 3 s. */
	for (int i = 0; i < 60; i++) {
		mg_connparam_busy(MG_XFER_DFU);
		if (i == 0) {
			settle();
			zassert_true(mg_connparam_latency_off());
			assert_req(1, 0);
			mg_connparam_updated(MIN_I, 0, TMO);
		}
		k_sleep(K_MSEC(50));
	}
	zassert_true(mg_connparam_latency_off(), "still on while chunks arrive");
	zassert_equal(fake_nconn_reqs, 2, "one request for the whole upload");
	k_sleep(K_MSEC(HOLD - 300));
	zassert_true(mg_connparam_latency_off());
	k_sleep(K_MSEC(400));
	zassert_false(mg_connparam_latency_off(), "back on after the hold");
	assert_req(2, LAT);
	mg_connparam_updated(MIN_I, LAT, TMO);
	settle();
	zassert_equal(fake_nconn_reqs, 3);

	/* set_tokens chunks do the same. */
	mg_connparam_busy(MG_XFER_TOKENS);
	settle();
	assert_req(3, 0);
}

/* A disconnect ends it all; the next connection starts afresh. */
ZTEST(connparam, test_disconnect)
{
	mg_connparam_connected();
	mg_connparam_phy_done();
	mg_connparam_data_len_done();
	settle();
	mg_connparam_busy(MG_XFER_DFU);
	settle();
	mg_connparam_disconnected();
	int n = fake_nconn_reqs;

	k_sleep(K_SECONDS(10));
	zassert_equal(fake_nconn_reqs, n);
	zassert_false(mg_connparam_latency_off());
}

ZTEST_SUITE(connparam, NULL, setup, before, NULL, NULL);
```

## src/test_core.c
```c
/*
 * Copyright (c) Meta Platforms, Inc. and affiliates.
 *
 * Licensed under the Apache License, Version 2.0 (the "License");
 * you may not use this file except in compliance with the License.
 * You may obtain a copy of the License at
 *
 *     http://www.apache.org/licenses/LICENSE-2.0
 *
 * Unless required by applicable law or agreed to in writing, software
 * distributed under the License is distributed on an "AS IS" BASIS,
 * WITHOUT WARRANTIES OR CONDITIONS OF ANY KIND, either express or implied.
 * See the License for the specific language governing permissions and
 * limitations under the License.
 */

#include <string.h>

#include <zephyr/sys/byteorder.h>
#include <zephyr/ztest.h>

#include "fakes.h"
#include "mg_led.h"
#include "mg_core.h"
#include "mg_queue.h"
#include "mg_session.h"
#include "mg_settings.h"

/* Protocol engine through mg_session without session security. The secure
 * build covers the same commands behind authentication in test_secure.c. */
#if !defined(CONFIG_MG_SECURE)


static void rx(const uint8_t *buf, size_t len)
{
	mg_session_rx(MG_ATT_CONTROL, buf, len);
}

#define RX(...)                                                                                    \
	do {                                                                                       \
		const uint8_t _b[] = {__VA_ARGS__};                                                \
		rx(_b, sizeof(_b));                                                                \
	} while (0)

static void *setup(void)
{
	fake_init_once();
	return NULL;
}

static void before(void *f)
{
	ARG_UNUSED(f);
	mg_settings_reset();
	fake_reset();
	fake_connect();
}

static void after(void *f)
{
	ARG_UNUSED(f);
	mg_core_button(false);
	mg_session_disconnected();
}

static void assert_error(uint8_t cmd, uint16_t code)
{
	const struct fake_note *n = fake_find(MG_ATT_CONTROL, mg_command_error, 0);

	zassert_not_null(n, "no error notified");
	zassert_true(n->len >= 5);
	zassert_equal(n->data[1], cmd);
	zassert_equal(n->data[2], mg_error_data_code);
	zassert_equal(sys_get_le16(&n->data[3]), code, "code %u", sys_get_le16(&n->data[3]));
}

ZTEST(core, test_ready_after_subscribe)
{
	zassert_true(mg_core_is_ready());
	mg_session_subscribed(MG_ATT_CONTROL, false);
	zassert_false(mg_core_is_ready());
	mg_session_subscribed(MG_ATT_CONTROL, true);
	zassert_true(mg_core_is_ready());
	/* Data matters too: the audio goes there. */
	mg_session_subscribed(MG_ATT_DATA, false);
	zassert_false(mg_core_is_ready());
	mg_session_subscribed(MG_ATT_DATA, true);
	zassert_true(mg_core_is_ready());
}

/* The LED and the "mg.ble: link" log follow the same rule as the ESP32
 * gadgets: ready only when connected, subscribed and push-to-talk on. */
ZTEST(core, test_link_states)
{
	zassert_equal(fake_led_link, MG_LED_LINK_SESSION, "subscribed, push-to-talk off");
	RX(mg_command_set_settings, mg_setting_parameter_push_to_talk_enabled, 1);
	zassert_equal(fake_led_link, MG_LED_LINK_READY);
	/* The app unsubscribes while the link stays up. */
	mg_session_subscribed(MG_ATT_DATA, false);
	zassert_equal(fake_led_link, MG_LED_LINK_CONNECTING);
	mg_session_subscribed(MG_ATT_DATA, true);
	zassert_equal(fake_led_link, MG_LED_LINK_READY, "push-to-talk is per connection: kept");
	RX(mg_command_set_settings, mg_setting_parameter_push_to_talk_enabled, 0);
	zassert_equal(fake_led_link, MG_LED_LINK_SESSION);
	RX(mg_command_set_settings, mg_setting_parameter_push_to_talk_enabled, 1);
	/* Any disconnect: never "never connected" again. */
	mg_session_disconnected();
	zassert_equal(fake_led_link, MG_LED_LINK_DISCONNECTED);
	/* A reconnection that never subscribes stays connecting, and push-to-talk is off. */
	mg_session_connected();
	zassert_equal(fake_led_link, MG_LED_LINK_CONNECTING);
	zassert_equal(mg_settings_get()->push_to_talk_enabled, 0);
	mg_session_disconnected();
	fake_connect();
	zassert_equal(fake_led_link, MG_LED_LINK_SESSION);
}

ZTEST(core, test_assistant_state)
{
	int faces = fake_led_faces;

	RX(mg_command_assistant_state, mg_assistant_state_responding);
	zassert_equal(fake_nnotes, 0, "no reply");
	zassert_equal(fake_led_face, MG_LED_FACE_RESPONDING);
	RX(mg_command_assistant_state, mg_assistant_state_done);
	zassert_equal(fake_led_face, MG_LED_FACE_DONE);
	RX(mg_command_assistant_state, mg_assistant_state_error);
	zassert_equal(fake_led_face, MG_LED_FACE_ERROR);
	RX(mg_command_assistant_state, mg_assistant_state_idle);
	zassert_equal(fake_led_face, MG_LED_FACE_IDLE);
	zassert_equal(fake_led_faces, faces + 4);
	RX(mg_command_assistant_state, 1); /* reserved */
	assert_error(mg_command_assistant_state, mg_error_code_invalid_value);
	fake_reset();
	RX(mg_command_assistant_state);
	assert_error(mg_command_assistant_state, mg_error_code_invalid_length);

	/* A client that has reported states: thinking once an utterance ends,
	 * and it stays there however long the reply takes to start. */
	RX(mg_command_start_mic);
	fake_audio_state = MG_AUDIO_IDLE;
	mg_core_audio_idle();
	zassert_equal(fake_led_face, MG_LED_FACE_THINKING);
	k_sleep(K_MSEC(CONFIG_MG_STATE_COMPAT_TIMEOUT_MS + 1000));
	zassert_equal(fake_led_face, MG_LED_FACE_THINKING, "no compat done for this client");

	/* A fresh connection, like the iOS app: it never sends thinking, so at
	 * stop_mic it hasn't sent any assistant_state yet. Thinking, not done. */
	mg_session_disconnected();
	zassert_equal(fake_led_face, MG_LED_FACE_IDLE, "idle on disconnect");
	fake_connect();
	RX(mg_command_set_settings, mg_setting_parameter_push_to_talk_enabled, 1);
	mg_core_button(true);
	mg_core_button(false);
	fake_audio_state = MG_AUDIO_IDLE;
	mg_core_audio_idle();
	zassert_equal(fake_led_face, MG_LED_FACE_THINKING, "thinking at stop_mic");
	/* responding 2.8 s later takes over; the compat timeout never fires. */
	k_sleep(K_MSEC(2800));
	RX(mg_command_assistant_state, mg_assistant_state_responding);
	zassert_equal(fake_led_face, MG_LED_FACE_RESPONDING);
	k_sleep(K_MSEC(CONFIG_MG_STATE_COMPAT_TIMEOUT_MS + 1000));
	zassert_equal(fake_led_face, MG_LED_FACE_RESPONDING, "no stray done");
	RX(mg_command_assistant_state, mg_assistant_state_done);
	zassert_equal(fake_led_face, MG_LED_FACE_DONE);

	/* An older client that never sends assistant_state: thinking, then done
	 * after the compat timeout (then idle, by the LED's own timer). */
	mg_session_disconnected();
	fake_connect();
	RX(mg_command_set_settings, mg_setting_parameter_push_to_talk_enabled, 1);
	mg_core_button(true);
	mg_core_button(false);
	fake_audio_state = MG_AUDIO_IDLE;
	mg_core_audio_idle();
	zassert_equal(fake_led_face, MG_LED_FACE_THINKING);
	k_sleep(K_MSEC(CONFIG_MG_STATE_COMPAT_TIMEOUT_MS - 1000));
	zassert_equal(fake_led_face, MG_LED_FACE_THINKING, "not yet");
	k_sleep(K_MSEC(2000));
	zassert_equal(fake_led_face, MG_LED_FACE_DONE, "compat done");

	/* A disconnect during thinking cancels the compat timer. */
	mg_core_button(true);
	mg_core_button(false);
	fake_audio_state = MG_AUDIO_IDLE;
	mg_core_audio_idle();
	zassert_equal(fake_led_face, MG_LED_FACE_THINKING);
	mg_session_disconnected();
	faces = fake_led_faces;
	k_sleep(K_MSEC(CONFIG_MG_STATE_COMPAT_TIMEOUT_MS + 1000));
	zassert_equal(fake_led_faces, faces, "nothing after the disconnect");
	zassert_equal(fake_led_face, MG_LED_FACE_IDLE);
	fake_connect();

	/* An audio idle without a capture (a clip download) is no turn. */
	faces = fake_led_faces;
	mg_core_audio_idle();
	zassert_equal(fake_led_faces, faces);
}

ZTEST(core, test_request_status)
{
	RX(mg_command_request_status);
	zassert_equal(fake_nnotes, 5);

	/* change_data_type with the SBC format. */
	const struct fake_note *n = &fake_notes[0];

	zassert_equal(n->len, 9);
	zassert_equal(n->data[0], mg_command_change_data_type);
	zassert_equal(n->data[1], mg_data_type_audio_sbc);
	zassert_equal(sys_get_le16(&n->data[2]), 16000);
	zassert_equal(n->data[4], 1);
	zassert_equal(sys_get_le16(&n->data[5]), 60);
	zassert_equal(sys_get_le16(&n->data[7]), 8000);

	/* Command list, then the typed start_mic codec list. */
	n = &fake_notes[1];
	zassert_equal(n->data[0], mg_command_supported_features);
	zassert_not_null(memchr(&n->data[1], mg_command_start_mic, n->len - 1));
	zassert_not_null(memchr(&n->data[1], mg_command_audio_queue, n->len - 1));
	zassert_not_null(memchr(&n->data[1], mg_command_set_settings, n->len - 1));
	zassert_is_null(memchr(&n->data[1], 0x80, n->len - 1), "0x80 is reserved");
	/* Only commands the device accepts. */
	zassert_is_null(memchr(&n->data[1], mg_command_gesture, n->len - 1));
	zassert_is_null(memchr(&n->data[1], mg_command_error, n->len - 1));
	zassert_is_null(memchr(&n->data[1], mg_command_change_data_type, n->len - 1));
	zassert_is_null(memchr(&n->data[1], mg_command_supported_features, n->len - 1));
	zassert_not_null(memchr(&n->data[1], mg_command_token_proof, n->len - 1));
	zassert_not_null(memchr(&n->data[1], mg_command_assistant_state, n->len - 1));
	zassert_not_null(memchr(&n->data[1], mg_command_device_action, n->len - 1));
	zassert_equal(n->len, 1 + 10,
		      "start/stop_mic, gain, status, get/set_settings, queue, token_proof, "
		      "assistant_state, device_action");

	n = &fake_notes[2];
	const uint8_t codecs[] = {mg_command_supported_features, mg_command_sub_feature,
				  mg_command_start_mic, mg_data_type_audio_sbc,
				  mg_data_type_audio_lc3};
	zassert_equal(n->len, sizeof(codecs));
	zassert_mem_equal(n->data, codecs, sizeof(codecs));

	/* Device actions: the throughput test. */
	n = &fake_notes[3];
	const uint8_t actions[] = {mg_command_supported_features, mg_command_sub_feature,
				   mg_command_device_action, mg_device_action_throughput_test};
	zassert_equal(n->len, sizeof(actions));
	zassert_mem_equal(n->data, actions, sizeof(actions));

	/* The typed settings list: exactly what get/set_settings accept. */
	n = &fake_notes[4];
#if defined(CONFIG_MG_HAPTICS)
	const uint8_t settings[] = {mg_command_supported_features, mg_command_sub_feature,
				    mg_command_set_settings, mg_setting_parameter_spec_version,
				    mg_setting_parameter_push_to_talk_enabled,
				    mg_setting_parameter_haptics_enabled,
				    mg_setting_parameter_ptt_buzz_freq_hz,
				    mg_setting_parameter_ptt_buzz_duration_ms,
				    mg_setting_parameter_ptt_buzz_volume_percent,
				    mg_setting_parameter_audio_codec,
				    mg_setting_parameter_audio_queue_enabled};
#else
	/* No vibration motor: no haptics or ptt_buzz_* settings. */
	const uint8_t settings[] = {mg_command_supported_features, mg_command_sub_feature,
				    mg_command_set_settings, mg_setting_parameter_spec_version,
				    mg_setting_parameter_push_to_talk_enabled,
				    mg_setting_parameter_audio_codec,
				    mg_setting_parameter_audio_queue_enabled};
#endif
	zassert_equal(n->len, sizeof(settings), "%u", n->len);
	zassert_mem_equal(n->data, settings, sizeof(settings));
}

ZTEST(core, test_unknown_command)
{
	RX(0x05);
	assert_error(0x05, mg_error_code_unsupported);
	fake_reset();
	RX(0x80, 0, 1, 1); /* reserved for a future security extension */
	assert_error(0x80, mg_error_code_unsupported);
}

ZTEST(core, test_start_stop_mic)
{
	RX(mg_command_start_mic);
	zassert_equal(fake_audio_starts, 1);
	zassert_equal(fake_audio_codec, mg_data_type_audio_sbc, "default codec");
	zassert_false(fake_audio_ptt);

	RX(mg_command_start_mic, mg_data_type_audio_lc3, 0xaa, 0xbb); /* trailing bytes ignored */
	zassert_equal(fake_audio_starts, 2);
	zassert_equal(fake_audio_codec, mg_data_type_audio_lc3);

	RX(mg_command_stop_mic);
	zassert_equal(fake_audio_stops, 1);
	zassert_equal(fake_nnotes, 0, "stop_mic comes from the audio thread, after the last chunk");

	RX(mg_command_start_mic, mg_data_type_audio_opus);
	assert_error(mg_command_start_mic, mg_error_code_invalid_value);
	zassert_equal(fake_audio_starts, 2);
}

ZTEST(core, test_mic_gain)
{
	RX(mg_command_set_mic_gain, 80);
	zassert_equal(fake_audio_gain, 80);
	RX(mg_command_set_mic_gain, 0);
	assert_error(mg_command_set_mic_gain, mg_error_code_invalid_value);
	fake_reset();
	RX(mg_command_set_mic_gain);
	assert_error(mg_command_set_mic_gain, mg_error_code_invalid_length);
}

#if !defined(CONFIG_MG_HAPTICS)
/* A board without a vibration motor refuses the haptics settings. */
ZTEST(core, test_no_motor)
{
	RX(mg_command_get_settings, mg_setting_parameter_ptt_buzz_freq_hz);
	assert_error(mg_command_get_settings, mg_error_code_unsupported);
	fake_reset();
	RX(mg_command_get_settings);
	zassert_equal(fake_notes[0].len, 1 + 4 * 2, "spec, ptt, codec, queue");
	zassert_is_null(memchr(&fake_notes[0].data[1], mg_setting_parameter_haptics_enabled, 8));
	for (uint8_t p = mg_setting_parameter_haptics_enabled;
	     p <= mg_setting_parameter_ptt_buzz_volume_percent; p++) {
		uint8_t v[3] = {p, 1, 0};

		fake_reset();
		const uint8_t m[] = {mg_command_set_settings, v[0], v[1], v[2]};

		rx(m, 2 + mg_settings_value_size(p));
		assert_error(mg_command_set_settings, mg_error_code_unsupported);
	}
	/* Push-to-talk works, without the activation buzz. */
	RX(mg_command_set_settings, mg_setting_parameter_push_to_talk_enabled, 1,
	   mg_setting_parameter_haptics_enabled, 1);
	zassert_equal(mg_settings_get()->push_to_talk_enabled, 1, "applied before the refusal");
	mg_core_button(true);
	zassert_equal(fake_audio_starts, 1);
	zassert_equal(fake_buzzes, 0);
	mg_core_button(false);
	RX(mg_command_set_settings, mg_setting_parameter_push_to_talk_enabled, 0);
}
#endif

ZTEST(core, test_get_settings)
{
	Z_TEST_SKIP_IFNDEF(CONFIG_MG_HAPTICS);
	RX(mg_command_get_settings, mg_setting_parameter_spec_version,
	   mg_setting_parameter_ptt_buzz_freq_hz, mg_setting_parameter_audio_codec);
	const uint8_t want[] = {mg_command_get_settings,
				mg_setting_parameter_spec_version, MG_SPEC_VERSION,
				mg_setting_parameter_ptt_buzz_freq_hz, 210, 0,
				mg_setting_parameter_audio_codec, mg_data_type_audio_sbc};

	zassert_equal(fake_nnotes, 1);
	zassert_equal(fake_notes[0].len, sizeof(want));
	zassert_mem_equal(fake_notes[0].data, want, sizeof(want));

	fake_reset();
	RX(mg_command_get_settings);
	zassert_equal(fake_notes[0].len, 1 + 6 * 2 + 2 * 3, "all eight settings");

	fake_reset();
	RX(mg_command_get_settings, 1);
	assert_error(mg_command_get_settings, mg_error_code_unsupported);
}

ZTEST(core, test_set_settings)
{
	Z_TEST_SKIP_IFNDEF(CONFIG_MG_HAPTICS);
	RX(mg_command_set_settings, mg_setting_parameter_push_to_talk_enabled, 1,
	   mg_setting_parameter_audio_codec, mg_data_type_audio_lc3);
	zassert_equal(fake_nnotes, 0, "no reply on success");
	zassert_equal(mg_settings_get()->push_to_talk_enabled, 1);
	zassert_equal(mg_settings_get()->audio_codec, mg_data_type_audio_lc3);

	RX(mg_command_set_settings, 0x7f, 1);
	assert_error(mg_command_set_settings, mg_error_code_unsupported);
	fake_reset();
	RX(mg_command_set_settings, mg_setting_parameter_haptics_enabled);
	assert_error(mg_command_set_settings, mg_error_code_invalid_length);
	fake_reset();
	RX(mg_command_set_settings, mg_setting_parameter_ptt_buzz_volume_percent, 200);
	assert_error(mg_command_set_settings, mg_error_code_invalid_value);

	/* The saved codec is used for device-initiated capture. */
	fake_reset();
	mg_core_button(true);
	zassert_equal(fake_audio_codec, mg_data_type_audio_lc3);
	mg_core_button(false);

	RX(mg_command_set_settings, mg_setting_parameter_push_to_talk_enabled, 0,
	   mg_setting_parameter_audio_codec, mg_data_type_audio_sbc);
}

ZTEST(core, test_ptt_disabled_reports_gestures)
{
	mg_core_button(true);
	mg_core_button(false);
	zassert_equal(fake_nnotes, 2);
	zassert_equal(fake_notes[0].data[0], mg_command_gesture);
	zassert_equal(fake_notes[0].data[1], mg_gesture_button_down);
	zassert_equal(fake_notes[1].data[1], mg_gesture_button_up);
	zassert_equal(fake_audio_starts, 0);
	zassert_equal(fake_buzzes, 0);
}

ZTEST(core, test_ptt)
{
	Z_TEST_SKIP_IFNDEF(CONFIG_MG_HAPTICS);
	RX(mg_command_set_settings, mg_setting_parameter_push_to_talk_enabled, 1,
	   mg_setting_parameter_haptics_enabled, 1);
	mg_core_button(true);
	zassert_equal(fake_count(MG_ATT_CONTROL, mg_command_gesture), 1);
	zassert_equal(fake_notes[0].data[1], mg_gesture_button_down);
	zassert_equal(fake_buzzes, 1, "activation buzz (LED)");
	zassert_equal(fake_audio_starts, 1);
	zassert_true(fake_audio_ptt);
	zassert_equal(fake_audio_codec, mg_data_type_audio_sbc);

	mg_core_button(false);
	zassert_equal(fake_notes[1].data[0], mg_command_gesture);
	zassert_equal(fake_notes[1].data[1], mg_gesture_button_up);
	zassert_equal(fake_audio_stops, 1);

	/* Haptics off: no buzz. The last start_mic codec wins. */
	RX(mg_command_set_settings, mg_setting_parameter_haptics_enabled, 0);
	RX(mg_command_start_mic, mg_data_type_audio_lc3);
	RX(mg_command_stop_mic);
	mg_core_button(true);
	zassert_equal(fake_buzzes, 1);
	zassert_equal(fake_audio_codec, mg_data_type_audio_lc3);
	mg_core_button(false);

	/* A new connection forgets that codec, and push-to-talk is off again
	 * until the client enables it. */
	mg_session_disconnected();
	fake_connect();
	zassert_equal(mg_settings_get()->push_to_talk_enabled, 0);
	zassert_equal(mg_settings_get()->haptics_enabled, 0);
	int starts = fake_audio_starts;

	mg_core_button(true);
	mg_core_button(false);
	zassert_equal(fake_audio_starts, starts, "gestures only");
	RX(mg_command_set_settings, mg_setting_parameter_push_to_talk_enabled, 1);
	mg_core_button(true);
	zassert_equal(fake_audio_codec, mg_data_type_audio_sbc);
	mg_core_button(false);
	RX(mg_command_set_settings, mg_setting_parameter_push_to_talk_enabled, 0,
	   mg_setting_parameter_haptics_enabled, 1);
}

ZTEST(core, test_offline_recording)
{
	RX(mg_command_set_settings, mg_setting_parameter_audio_queue_enabled, 1);
	mg_session_disconnected();
	fake_reset();

	mg_core_button(true);
	zassert_equal(fake_audio_recordings, 1);
	zassert_equal(fake_nnotes, 0, "no gestures without a client");
	mg_core_button(false);
	zassert_equal(fake_audio_stops, 1);

	/* Disabled: nothing recorded. */
	fake_connect();
	RX(mg_command_set_settings, mg_setting_parameter_audio_queue_enabled, 0);
	mg_session_disconnected();
	mg_core_button(true);
	mg_core_button(false);
	zassert_equal(fake_audio_recordings, 1);
	fake_connect();
}

ZTEST(core, test_audio_queue_commands)
{
	struct mg_queue_status st;

	zassert_equal(mg_queue_clear(), 0);
	zassert_equal(mg_queue_begin(mg_data_type_audio_sbc, 1234), 0);
	zassert_equal(mg_queue_append("0123456789", 10), 0);
	zassert_equal(mg_queue_end(), 0);
	mg_queue_get_status(&st);

	RX(mg_command_audio_queue, mg_audio_queue_command_status);
	const struct fake_note *n = fake_find(MG_ATT_CONTROL, mg_command_audio_queue, 0);

	zassert_not_null(n);
	zassert_equal(n->len, 13);
	zassert_equal(n->data[1], mg_audio_queue_command_status);
	zassert_equal(n->data[2], 0, "queue disabled");
	zassert_equal(sys_get_le32(&n->data[3]), st.used_bytes);
	zassert_equal(sys_get_le32(&n->data[7]), st.capacity_bytes);
	zassert_equal(sys_get_le16(&n->data[11]), 1);

	fake_reset();
	RX(mg_command_audio_queue, mg_audio_queue_command_clip_info, 0, 0);
	n = fake_find(MG_ATT_CONTROL, mg_command_audio_queue, 0);
	zassert_not_null(n);
	zassert_equal(n->len, 13);
	zassert_equal(n->data[1], mg_audio_queue_command_clip_info);
	zassert_equal(sys_get_le16(&n->data[2]), 0);
	zassert_equal(n->data[4], mg_data_type_audio_sbc);
	zassert_equal(sys_get_le32(&n->data[5]), 1234);
	zassert_equal(sys_get_le32(&n->data[9]), 10);

	fake_reset();
	RX(mg_command_audio_queue, mg_audio_queue_command_clip_info, 1, 0);
	assert_error(mg_command_audio_queue, mg_error_code_invalid_value);
	fake_reset();
	RX(mg_command_audio_queue, mg_audio_queue_command_clip_info, 0);
	assert_error(mg_command_audio_queue, mg_error_code_invalid_length);
	fake_reset();
	RX(mg_command_audio_queue, 2);
	assert_error(mg_command_audio_queue, mg_error_code_unsupported);

	fake_reset();
	RX(mg_command_audio_queue, mg_audio_queue_command_read_clip, 0, 0);
	zassert_equal(fake_audio_clip_reads, 1);
	zassert_equal(fake_audio_clip, 0);

	/* Live audio wins: read_clip is busy while it runs, start_mic abandons
	 * a download. */
	RX(mg_command_start_mic);
	zassert_equal(fake_audio_state, MG_AUDIO_LIVE);
	fake_reset();
	fake_audio_state = MG_AUDIO_LIVE;
	RX(mg_command_audio_queue, mg_audio_queue_command_read_clip, 0, 0);
	assert_error(mg_command_audio_queue, mg_error_code_busy);
	RX(mg_command_stop_mic);

	fake_reset();
	RX(mg_command_audio_queue, mg_audio_queue_command_clear);
	n = fake_find(MG_ATT_CONTROL, mg_command_audio_queue, 0);
	zassert_not_null(n);
	zassert_equal(n->data[1], mg_audio_queue_command_status);
	zassert_equal(sys_get_le16(&n->data[11]), 0, "cleared");
	zassert_equal(sys_get_le32(&n->data[3]), 0);
}

ZTEST(core, test_error_log_string)
{
	RX(mg_command_start_mic, mg_data_type_audio_pcm);
	const struct fake_note *n = fake_find(MG_ATT_CONTROL, mg_command_error, 0);

	zassert_not_null(n);
	zassert_true(n->len > 8);
	zassert_equal(n->data[5], mg_error_data_log);
	uint16_t l = sys_get_le16(&n->data[6]);

	zassert_equal(n->len, 8 + l);
	zassert_mem_equal(&n->data[8], "codec not supported", l);
}

ZTEST_SUITE(core, NULL, setup, before, after, NULL);

#endif /* !CONFIG_MG_SECURE */
```
